#ifndef ICONS_H
#define ICONS_H

#include <Arduino.h>

// Icon size: 40x40 pixels
#define ICON_WIDTH 40
#define ICON_HEIGHT 40

// Placeholder icons - replace with actual bitmaps later
// Format: 1 bit per pixel, MSB first, 40 pixels wide = 5 bytes per row

// Sunny / Clear day
const unsigned char icon_sunny[] PROGMEM = {
    0x00, 0x00, 0x00, 0x00, 0x00, 0x00, 0x00, 0x00, 0x00, 0x00, 0x00, 0x00,
    0x00, 0x00, 0x00, 0x00, 0x00, 0x00, 0x00, 0x00, 0x00, 0x00, 0x00, 0x00,
    0x00, 0x00, 0x00, 0x08, 0x00, 0x00, 0x00, 0x00, 0x18, 0x00, 0x00, 0x00,
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    0x00, 0x00, 0x00, 0x00, 0x00, 0x00, 0x00, 0x00};

// Clear night / Moon
const unsigned char icon_moon[] PROGMEM = {
    0x00, 0x00, 0x00, 0x00, 0x00, 0x00, 0x00, 0x00, 0x00, 0x00, 0x00, 0x00,
    0x00, 0x00, 0x00, 0x00, 0x00, 0x00, 0x00, 0x00, 0x00, 0x00, 0x00, 0x00,
    0x00, 0x00, 0x00, 0x00, 0x00, 0x00, 0x00, 0x00, 0x00, 0x00, 0x00, 0x00,
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    0x00, 0x00, 0x00, 0x00, 0x00, 0x00, 0x00, 0x00};

// Cloudy
const unsigned char icon_cloudy[] PROGMEM = {
    0x00, 0x00, 0x00, 0x00, 0x00, 0x00, 0x00, 0x00, 0x00, 0x00, 0x00, 0x00,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 0x00
};

// Rainy
const unsigned char icon_rain[] PROGMEM = {
    0x00, 0x00, 0x00, 0x00, 0x00, 0x00, 0x00, 0x00, 0x00, 0x00, 0x00, 0x00,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 0x00
};

// Partly cloudy day
const unsigned char icon_partly_cloudy[] PROGMEM = {
    0x00, 0x00, 0x00, 0x00, 0x00, 0x00, 0x00, 0x00, 0x00, 0x00, 0x00, 0x00,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 0x00
};

// Thunderstorm
const unsigned char icon_thunder[] PROGMEM = {
    0x00, 0x00, 0x00, 0x00, 0x00, 0x00, 0x00, 0x00, 0x00, 0x00, 0x00, 0x00,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 0x00
};

// Snow
const unsigned char icon_snow[] PROGMEM = {
    0x00, 0x00, 0x00, 0x00, 0x00, 0x00, 0x00, 0x00, 0x00, 0x00, 0x00, 0x00,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 0x00
};

// Fog / Mist
const unsigned char icon_fog[] PROGMEM = {
    0x00, 0x00, 0x00, 0x00, 0x00, 0x00, 0x00, 0x00, 0x00, 0x00, 0x00, 0x00,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 0x00
};

// Icon type enum
enum WeatherIconType {
  ICON_SUNNY,
  ICON_MOON,
  ICON_CLOUDY,
  ICON_RAIN,
  ICON_PARTLY_CLOUDY,
  ICON_THUNDER,
  ICON_SNOW,
  ICON_FOG
};

// Get icon based on condition and day/night
const unsigned char *getWeatherIcon(const String &condition, bool isDay) {
  String cond = condition;
  cond.toLowerCase();

  // Rain conditions
  if (cond.indexOf("chuva") >= 0 || cond.indexOf("rain") >= 0 ||
      cond.indexOf("chuvisco") >= 0 || cond.indexOf("drizzle") >= 0) {
    return icon_rain;
  }

  // Thunder
  if (cond.indexOf("trovoada") >= 0 || cond.indexOf("thunder") >= 0 ||
      cond.indexOf("raio") >= 0) {
    return icon_thunder;
  }

  // Snow
  if (cond.indexOf("neve") >= 0 || cond.indexOf("snow") >= 0 ||
      cond.indexOf("gelo") >= 0 || cond.indexOf("ice") >= 0) {
    return icon_snow;
  }

  // Fog/Mist
  if (cond.indexOf("nevoeiro") >= 0 || cond.indexOf("fog") >= 0 ||
      cond.indexOf("neblina") >= 0 || cond.indexOf("mist") >= 0) {
    return icon_fog;
  }

  // Cloudy
  if (cond.indexOf("nublado") >= 0 || cond.indexOf("cloudy") >= 0 ||
      cond.indexOf("encoberto") >= 0 || cond.indexOf("overcast") >= 0) {
    return icon_cloudy;
  }

  // Partly cloudy
  if (cond.indexOf("parcialmente") >= 0 || cond.indexOf("partly") >= 0) {
    return icon_partly_cloudy;
  }

  // Clear/Sunny - check day or night
  if (cond.indexOf("sol") >= 0 || cond.indexOf("sunny") >= 0 ||
      cond.indexOf("limpo") >= 0 || cond.indexOf("clear") >= 0 ||
      cond.indexOf("ensolarado") >= 0) {
    return isDay ? icon_sunny : icon_moon;
  }

  // Default based on day/night
  return isDay ? icon_sunny : icon_moon;
}

// ==================== Status Bar Icons (small) ====================

// WiFi icon dimensions: 12x10
#define WIFI_ICON_WIDTH 12
#define WIFI_ICON_HEIGHT 10

// WiFi connected icon (12x10)
const unsigned char icon_wifi[] PROGMEM = {
    0x1F, 0x80, 0x7F, 0xE0, 0xE0, 0x70, 0x1F, 0x80, 0x3F, 0xC0,
    0x70, 0xE0, 0x0F, 0x00, 0x0F, 0x00, 0x06, 0x00, 0x06, 0x00,
};

// WiFi disconnected icon (12x10) - X over wifi
const unsigned char icon_wifi_off[] PROGMEM = {
    0x1F, 0x80, 0x67, 0x60, 0xE3, 0x70, 0x1B, 0x80, 0x3F, 0xC0,
    0x7B, 0xE0, 0x0F, 0x00, 0x1F, 0x80, 0x36, 0xC0, 0x66, 0x60,
};

// Battery icon dimensions: 16x10
#define BATTERY_ICON_WIDTH 16
#define BATTERY_ICON_HEIGHT 10

// Battery full (16x10)
const unsigned char icon_battery_full[] PROGMEM = {
    0xFF, 0xF8, 0x80, 0x0C, 0xBF, 0xFE, 0xBF, 0xFE, 0xBF, 0xFE,
    0xBF, 0xFE, 0xBF, 0xFE, 0xBF, 0xFE, 0x80, 0x0C, 0xFF, 0xF8,
};

// Battery medium (16x10)
const unsigned char icon_battery_med[] PROGMEM = {
    0xFF, 0xF8, 0x80, 0x0C, 0xBF, 0x8E, 0xBF, 0x8E, 0xBF, 0x8E,
    0xBF, 0x8E, 0xBF, 0x8E, 0xBF, 0x8E, 0x80, 0x0C, 0xFF, 0xF8,
};

// Battery low (16x10)
const unsigned char icon_battery_low[] PROGMEM = {
    0xFF, 0xF8, 0x80, 0x0C, 0xBC, 0x0E, 0xBC, 0x0E, 0xBC, 0x0E,
    0xBC, 0x0E, 0xBC, 0x0E, 0xBC, 0x0E, 0x80, 0x0C, 0xFF, 0xF8,
};

// Battery empty (16x10)
const unsigned char icon_battery_empty[] PROGMEM = {
    0xFF, 0xF8, 0x80, 0x0C, 0x80, 0x0E, 0x80, 0x0E, 0x80, 0x0E,
    0x80, 0x0E, 0x80, 0x0E, 0x80, 0x0E, 0x80, 0x0C, 0xFF, 0xF8,
};

// Get battery icon based on percentage
const unsigned char *getBatteryIcon(int percentage) {
  if (percentage >= 75)
    return icon_battery_full;
  if (percentage >= 40)
    return icon_battery_med;
  if (percentage >= 15)
    return icon_battery_low;
  return icon_battery_empty;
}

#endif // ICONS_H
